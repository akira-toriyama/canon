/*
 * One CDC ACM instance. The xiao_ble board defines board_cdc_acm_uart (Zephyr
 * boards/common/usb/cdc_acm_serial.dtsi; the shell, mcumgr and BT UART chosen
 * nodes point at it) and the module's shield overlay adds cdc_acm_uart for its
 * console. Every okay instance becomes a CDC ACM function of the USB device, so
 * keeping both would hand scripts/flash-prospector.sh two ports. The console
 * moves to the board's instance, which --logging builds then use.
 */

/ {
    chosen {
        zephyr,console = &board_cdc_acm_uart;
    };
};

/delete-node/ &cdc_acm_uart;
