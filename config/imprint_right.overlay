// Only the shared dtsi files, but the file has to exist: ZMK takes the first user
// overlay that matches the shield, and config/imprint.overlay (the "imprint"
// prefix) would come before imprint_left.overlay, so one overlay shared by
// both halves would silently drop the left trackball's forwarding.
#include "lantern_rail.dtsi"
#include "cdc_acm_port.dtsi"
#include "lantern_keys.dtsi"

// This half's 29 key LEDs and the key under each, in chain order, the mirror
// of the left half's (imprint_left.overlay says where the order comes from
// and that the probe confirms it).
&led_strip {
    chain-length = <29>;
};

&lantern_keys {
    positions = <
        18 30  6
        19 31 41  7
        20 32 42  8
        21 33 43  9
        22 34 44 10
        23 35 45 11
        51 50 49 57 56 55
    >;
};
