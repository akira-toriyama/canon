// Included in the keymap's combos { } node. A combo takes both keys' presses,
// so its hold gives back the modifiers that their mod-taps (TD_*) would hold.

    combo_kana {
      key-positions = <KEY_POSITION_LL KEY_POSITION_LM>;
      bindings = <&ime_kana LS(LEFT_COMMAND) KANA>;
    };
    combo_eiji {
      key-positions = <KEY_POSITION_RM KEY_POSITION_RR>;
      bindings = <&ime_eiji LC(LALT) EIJI>;
    };
