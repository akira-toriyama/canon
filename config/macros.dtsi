// Included in the keymap's macros { } node.

    eiji_macro: eiji_macro {
      compatible = "zmk,behavior-macro-one-param";
      #binding-cells = <1>;
      bindings = <&macro_tap &kp EIJI>, <&macro_param_1to1>, <&macro_press &kp MACRO_PLACEHOLDER>, <&macro_pause_for_release>, <&macro_param_1to1>, <&macro_release &kp MACRO_PLACEHOLDER>;
    };
    kana: kana {
      compatible = "zmk,behavior-macro";
      #binding-cells = <0>;
      bindings = <&kp KANA>;
    };
    eiji: eiji {
      compatible = "zmk,behavior-macro";
      #binding-cells = <0>;
      bindings = <&kp EIJI>;
    };

    TU_MOD(t_ll_ctrl, T_LL_LAYER, LCTRL)
    TU_MOD(t_lm_alt,  T_LM_LAYER, LALT)

    // en_*: eiji_macro with the key fixed, as separate 0-cell behaviors: their
    // keymap-drawer labels (raw_binding_map, generated from eiji_macros.dtsi)
    // key on the behavior's name.
    #include "eiji_macros.dtsi"
