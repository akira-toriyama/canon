// Holds the EXT_POWER rail (assimilator-bt P1.02) off from boot. Both halves'
// overlays include it; the dongle has no EXT_POWER node.
//
// Why off: canon never lights the per-key LEDs behind the rail
// (CONFIG_ZMK_RGB_UNDERGLOW=n), yet the rail drew 10-18 mA per half at rest
// (0.79 mA while connected with the rail forced off; measured 2026-09-15).
//
// Why not zmk,ext-power-generic's own off state: ext_power_generic_init()
// enables the rail unconditionally, and settings_load() then reads
// "ext_power/state/EXT_POWER" back from NVS and enables it again, so patching
// the init alone loses to NVS. With status = "disabled" the driver's whole
// file, its settings handler included, leaves the build and a stored value
// has no reader: the rail is off deterministically, with no NVS erase and the
// BLE bonds kept.
//
// Why the hog: with the driver gone nothing configures P1.02, and in its reset
// state (input, high-Z) the rail's state cannot be told without the
// schematic. The hog runs after the GPIO controller (PRE_KERNEL_1) and drives
// the pin low.
//
// Why not a key (&ext_power EP_OFF / EP_ON): with the dongle the central has
// no EXT_POWER device, and zmk_behavior_invoke_binding() stops with -EIO in
// the convert step before the GLOBAL forwarding (ZMK app/src/behavior.c and
// app/src/behaviors/behavior_ext_power.c), so the press never reaches the
// halves.
//
// The pin copies the board's EXT_POWER control-gpios (zmk-keyboards
// boards/cyboard/assimilator-bt/assimilator-bt.dts): a renamed node fails the
// build here, a moved pin does not. To bring underglow back, drop this file
// (DEVICE_DT_GET of the disabled node fails the build).

#include <zephyr/dt-bindings/gpio/gpio.h>

&{/EXT_POWER} {
    status = "disabled";
};

&gpio1 {
    ext_power_off_hog {
        gpio-hog;
        gpios = <2 GPIO_ACTIVE_HIGH>;
        output-low;
    };
};
