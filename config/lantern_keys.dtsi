// The halves' key LEDs are zmk-lantern's (config/west.yml): its lantern,keys
// node names the strip (Cyboard's ws2812 node, chosen zmk,underglow), the key
// under each LED and the palette slot each key shows (CLAUDE.md, Invariants;
// the glossary: palette). ZMK's underglow is off on the halves (imprint.conf),
// the module paints the strip itself and asserts that. For both halves'
// overlays, which add the half's own positions and chain-length: the two
// tables below are the keymap's and so the same on both.
//
// slots: one entry per key position of imprint.keymap's chosen transform
// (imprint_letters_only_full_bottom_row, 58 keys; keypos.h numbers them), in
// the transform's shape: the key's palette slot, its band. Slots 0..4 left
// to right in five bands of about twelve keys: the outer three columns of
// the left half, its inner three, both thumb clusters, the right half's
// inner three, its outer three (t-69g7; the five colours of the day's
// sprite, slot 0 the liveliest, t-0967). Slot 5 is the palette's spare and
// appears nowhere. A slot the host left black shows slot 0's colour (the
// module's rule). The product halves paint no picture (imprint_left.conf:
// CONFIG_LANTERN_NO_PICTURE, the countdown off), so the bands show only as
// the colour of the crossing ring, the pressed key's band on both halves
// (t-6ttk); the module still asserts the table's length and range.
//
// coords: two entries per key position, in the same order: the key's x and
// then its y in hundredths of a key unit on the whole board, config/imprint.json
// (keymap-drawer's physical layout: each key's top left corner, every key one
// unit; the left half x 0-7.5 with its thumbs, the right 9-16.5, y 2-6.5, the
// inner columns 6.5 units apart) times 100, written out once since the
// layout is fixed. zmk-lantern's effects and its intro measure the board
// with it (t-6ttk, t-5v1f); the module asserts an x and a y per key position.
//
// scatter-weights: the scatter (zmk-lantern's CONFIG_LANTERN_SCATTER, t-skdt),
// a picture in place of the bands that the product does not build (the user
// chose the no picture): each half throws the slots over its own 29 keys at
// random, slot s on this percentage of them (slots 1.. rounded, slot 0 the
// rest, the 10 % the shares leave included: 18 / 6 / 3 / 1 / 1 of 29), a new
// throw every ten seconds while lit. The user's shares of 2026-10-21; slot
// 5, the spare, 0. Kept for a trial image (--kconfig CONFIG_LANTERN_SCATTER=y).

/ {
    lantern_keys: lantern_keys {
        compatible = "lantern,keys";
        strip = <&led_strip>;
        slots = <
            0 0 0 1 1 1          3 3 3 4 4 4
            0 0 0 1 1 1          3 3 3 4 4 4
            0 0 0 1 1 1          3 3 3 4 4 4
            0 0 0 1 1              3 3 4 4 4
                      2 2 2    2 2 2
                      2 2 2    2 2 2
        >;
        coords = <
               0 200    100 200    200 200    300 200    400 200    500 200   1150 200   1250 200   1350 200   1450 200   1550 200   1650 200
               0 300    100 300    200 300    300 300    400 300    500 300   1150 300   1250 300   1350 300   1450 300   1550 300   1650 300
               0 400    100 400    200 400    300 400    400 400    500 400   1150 400   1250 400   1350 400   1450 400   1550 400   1650 400
               0 500    100 500    200 500    300 500    400 500   1250 500   1350 500   1450 500   1550 500   1650 500
             550 550    650 550    750 550    900 550   1000 550   1100 550
             550 650    650 650    750 650    900 650   1000 650   1100 650
        >;
        scatter-weights = <50 20 10 5 5 0>;
    };
};
